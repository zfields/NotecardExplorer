#ifndef OLED_FEATHER_WING_H
#define OLED_FEATHER_WING_H

#include <Adafruit_GFX.h>
#include <Adafruit_SSD1306.h>
#include <Notecard.h>

#define DEFAULT_CHARACTER_HEIGHT 8
#define LINES_PER_SCREEN 4

// OLED FeatherWing buttons map to different pins depending on board.
// The I2C (Wire) bus may also be different.
#if defined(ESP8266)
  #define OFW_BUTTON_A  0
  #define OFW_BUTTON_B 16
  #define OFW_BUTTON_C  2
  #define OFW_WIRE Wire
#elif defined(ESP32)
  #define OFW_BUTTON_A 15
  #define OFW_BUTTON_B 32
  #define OFW_BUTTON_C 14
  #define OFW_WIRE Wire
#elif defined(ARDUINO_STM32_FEATHER)
  #define OFW_BUTTON_A PA15
  #define OFW_BUTTON_B PC7
  #define OFW_BUTTON_C PC5
  #define OFW_WIRE Wire
#elif defined(TEENSYDUINO)
  #define OFW_BUTTON_A  4
  #define OFW_BUTTON_B  3
  #define OFW_BUTTON_C  8
  #define OFW_WIRE Wire
#elif defined(ARDUINO_FEATHER52832)
  #define OFW_BUTTON_A 31
  #define OFW_BUTTON_B 30
  #define OFW_BUTTON_C 27
  #define OFW_WIRE Wire
#elif defined(ARDUINO_ADAFRUIT_FEATHER_RP2040)
  #define OFW_BUTTON_A  9
  #define OFW_BUTTON_B  8
  #define OFW_BUTTON_C  7
  #define OFW_WIRE Wire1
#else // 32u4, M0, M4, nrf52840 and 328p
  #define OFW_BUTTON_A  9
  #define OFW_BUTTON_B  6
  #define OFW_BUTTON_C  5
  #define OFW_WIRE Wire
#endif

bool scrolling_line[LINES_PER_SCREEN] = {0};

void displayBluesSplash (size_t splash_ms);
void displayJsonObject (J * json_object, bool wrap, size_t text_size);
void getCharacterHeightAndWidth (uint16_t * char_height, uint16_t * char_width);
size_t getScreenLineNumber (void);
size_t linesPerCharacter (size_t char_height);
void resetDisplay (void);
void updateScrollingLines (void);

Adafruit_SSD1306 display = Adafruit_SSD1306(128, 32, &OFW_WIRE);

const uint8_t PROGMEM blues_splash_data[] = {
    0b00000110,0b00001111,0b11111111,0b10000000,0b00000000,0b00000000,0b00000000,0b00000000,0b00000000,0b00000000,0b00000000,0b00000000,0b00000000,0b00000000,0b00000000,0b00000000,
    0b00011111,0b00000111,0b11111111,0b11100000,0b00000000,0b00000000,0b00000000,0b00000000,0b00000000,0b00000000,0b00000000,0b00000000,0b00000000,0b00000000,0b00000000,0b00000000,
    0b00111111,0b10000011,0b11111111,0b11110000,0b00000000,0b00000000,0b00000000,0b00000000,0b00000000,0b00000000,0b00000000,0b00000000,0b00000000,0b00000000,0b00000000,0b00000000,
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    0b00000111,0b11111111,0b11000001,0b10000000,0b00000000,0b00000000,0b00000000,0b00000000,0b00000000,0b00000000,0b00000000,0b00000000,0b00000000,0b00000000,0b00000000,0b00000000,
};

void displayBluesSplash (size_t splash_ms_) {
    display.clearDisplay();
    display.drawBitmap(0, 0, blues_splash_data, 128, 32, 1);
    display.display();
    delay(splash_ms_);
}

void displayJsonObject (J * json_object_, bool wrap_ = false, size_t text_size_ = 1) {
    uint16_t char_height, char_width;
    display.setTextWrap(wrap_);
    display.setTextSize(text_size_);
    getCharacterHeightAndWidth(&char_height, &char_width);
    size_t max_line_characters = ((display.width() / char_width) + sizeof(""));
    char *json = JConvertToJSONString(json_object_);
    if (!wrap_ && (strnlen(json, max_line_characters + 1) > max_line_characters)) {
        size_t first_scroll_line = getScreenLineNumber();
        size_t final_scroll_line = (first_scroll_line + (linesPerCharacter(char_height) - 1));
        for (size_t line = first_scroll_line ; line < (final_scroll_line + 1); ++line) {
            scrolling_line[line] = true;
        }
    }
    display.println(json);
    free(json);
    updateScrollingLines();
    display.display();
}

void getCharacterHeightAndWidth (uint16_t * char_height_, uint16_t * char_width_) {
    int16_t char_loc_x, char_loc_y, cursor_x = display.getCursorX(), cursor_y = display.getCursorY();
    display.getTextBounds("x", cursor_x, cursor_y, &char_loc_x, &char_loc_y, char_width_, char_height_);
}

size_t getScreenLineNumber (void) {
    return (display.getCursorY() / DEFAULT_CHARACTER_HEIGHT);
}

size_t linesPerCharacter (size_t char_height_) {
    return (char_height_ / DEFAULT_CHARACTER_HEIGHT);
}

void resetDisplay (void) {
    display.clearDisplay();
    display.setCursor(0, 0);
    for (size_t line = 0 ; line < LINES_PER_SCREEN ; ++line) {
        scrolling_line[line] = false;
    }
}

void updateScrollingLines (void) {
    bool scrolling_detected = false;
    size_t first_line = LINES_PER_SCREEN, final_line = 0;
    for (size_t line = 0; line < LINES_PER_SCREEN ; ++line) {
        if (scrolling_line[line]) {
            scrolling_detected = true;
            if (first_line > line) {
                first_line = line;
            }
            if (final_line < line) {
                final_line = line;
            }
        }
    }
    if (scrolling_detected) {
        display.startscrollleft(first_line, final_line);
    }
}

#endif // OLED_FEATHER_WING_H
